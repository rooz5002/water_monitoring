// ===========================================================================
//  svm_benchmark.ino
//  By Dr. Amir A Mokhtarzadeh
//  Aug 2026
//  On-device inference-latency benchmark for the PSO-ASVM (RBF SVC) classifier.
//
//  Target: original ESP32 (Xtensa LX6 @ 240 MHz) -- e.g. an ESP32-WROVER-B or
//  ESP32-WROOM-32 dev board. This is the same SoC used by the LilyGO
//  T-SIM7000G, so the measured latency represents the deployment platform.
//
//  What it does, in order:
//    1. Verifies the on-device predictions reproduce scikit-learn on the test set.
//    2. Warms up (100 inferences) to prime caches/branch predictor.
//    3. Measures MEAN latency with esp_timer over N (>=1000) inferences  <-- headline
//    4. Measures the per-inference distribution (sd/min/max) via the CPU cycle counter.
//    5. Reports the headroom factor against the 30-minute AFS sample cycle.
//
//  Setup:
//    - Run export_model.py on your laptop, copy the generated model.h next to this file.
//    - Arduino IDE: Tools > Board > "ESP32 Wrover Module" (or your WROOM board),
//      Upload, then open Serial Monitor at 115200 baud.
// ===========================================================================

#include <Arduino.h>
#include <math.h>
#include "esp_timer.h"

// --- precision: MUST match how you generated model.h -----------------------
//   float32  -> the single-precision hardware FPU path you would deploy (default)
//   double   -> only if you exported with --double AND deploy in double
#define USE_DOUBLE 0
#if USE_DOUBLE
  typedef double model_t;
  #define KEXP  exp
#else
  typedef float  model_t;
  #define KEXP  expf
#endif

#include "model.h"   // <-- generated by export_model.py (arrays must be same type as model_t)

static const int N_BENCH = 2000;   // timed inferences (>= 1000 as required by the reviewer)
static const int N_WARMUP = 100;

static model_t kbuf[N_SV];         // scratch buffer for kernel values
static int     START[N_CLASSES];   // starting index of each class's support vectors
volatile long  g_sink = 0;         // stops the compiler optimising the loop away

// One RBF-SVM prediction (standardisation + kernels + libsvm one-vs-one voting).
static inline int svm_predict(const model_t *x_raw) {
  // 1) standardise the raw feature vector
  model_t xs[N_FEATURES];
  for (int f = 0; f < N_FEATURES; ++f)
    xs[f] = (x_raw[f] - (model_t)SCALER_MEAN[f]) / (model_t)SCALER_SCALE[f];

  // 2) RBF kernel against every support vector: k = exp(-gamma * ||x - sv||^2)
  for (int j = 0; j < N_SV; ++j) {
    const model_t *svj = &SV[(size_t)j * N_FEATURES];
    model_t d2 = 0;
    for (int f = 0; f < N_FEATURES; ++f) {
      model_t diff = xs[f] - svj[f];
      d2 += diff * diff;
    }
    kbuf[j] = KEXP(-(model_t)GAMMA * d2);
  }

  // 3) one-vs-one decision + voting (exactly as libsvm/scikit-learn does it)
  int votes[N_CLASSES];
  for (int c = 0; c < N_CLASSES; ++c) votes[c] = 0;

  int p = 0;
  for (int i = 0; i < N_CLASSES; ++i) {
    for (int j = i + 1; j < N_CLASSES; ++j) {
      model_t sum = (model_t)INTERCEPT[p];
      const model_t *rowj = &DUAL[(size_t)(j - 1) * N_SV]; // coeffs for class i's SVs
      const model_t *rowi = &DUAL[(size_t)(i)     * N_SV]; // coeffs for class j's SVs
      for (int s = START[i]; s < START[i] + N_SUPPORT[i]; ++s) sum += rowj[s] * kbuf[s];
      for (int s = START[j]; s < START[j] + N_SUPPORT[j]; ++s) sum += rowi[s] * kbuf[s];
      if (sum > 0) votes[i]++; else votes[j]++;
      p++;
    }
  }

  int best = 0;
  for (int c = 1; c < N_CLASSES; ++c) if (votes[c] > votes[best]) best = c;
  return best;
}

void setup() {
  Serial.begin(115200);
  delay(600);

  setCpuFrequencyMhz(240);                       // pin the clock to 240 MHz
  const double freq_mhz = (double)getCpuFrequencyMhz();

  START[0] = 0;
  for (int c = 1; c < N_CLASSES; ++c) START[c] = START[c - 1] + N_SUPPORT[c - 1];

  Serial.println();
  Serial.println(F("=== PSO-ASVM on-device inference benchmark ==="));
  Serial.printf("CPU: %.0f MHz | precision: %s | N_SV=%d | N_FEATURES=%d | N_CLASSES=%d\n",
                freq_mhz, (USE_DOUBLE ? "double" : "float32"), N_SV, N_FEATURES, N_CLASSES);

  // ---- Step 1: correctness check against scikit-learn ---------------------
  int mism = 0;
  for (int t = 0; t < N_TEST; ++t) {
    int pred = svm_predict(&X_TEST[(size_t)t * N_FEATURES]);
    if (pred != Y_SKLEARN[t]) {
      mism++;
      Serial.printf("  mismatch @ test row %d: device=%d sklearn=%d\n", t, pred, Y_SKLEARN[t]);
    }
  }
  Serial.printf("Verification: %d / %d disagreements with scikit-learn\n", mism, N_TEST);

  // ---- Step 2: warm-up ----------------------------------------------------
  for (int i = 0; i < N_WARMUP; ++i)
    g_sink += svm_predict(&X_TEST[(size_t)(i % N_TEST) * N_FEATURES]);

  // ---- Step 3: headline MEAN latency via esp_timer ------------------------
  int64_t t0 = esp_timer_get_time();             // microseconds
  for (int i = 0; i < N_BENCH; ++i)
    g_sink += svm_predict(&X_TEST[(size_t)(i % N_TEST) * N_FEATURES]);
  int64_t t1 = esp_timer_get_time();

  double total_us = (double)(t1 - t0);
  double mean_us  = total_us / N_BENCH;
  Serial.printf("esp_timer : %d inferences in %.0f us  ->  mean %.3f us  (%.5f ms) / inference\n",
                N_BENCH, total_us, mean_us, mean_us / 1000.0);

  // ---- Step 4: per-inference distribution via CPU cycle counter -----------
  double s = 0, s2 = 0, mn = 1e18, mx = 0;
  for (int i = 0; i < N_BENCH; ++i) {
    uint32_t c0 = ESP.getCycleCount();
    g_sink += svm_predict(&X_TEST[(size_t)(i % N_TEST) * N_FEATURES]);
    uint32_t c1 = ESP.getCycleCount();
    double us = (double)(uint32_t)(c1 - c0) / freq_mhz;   // wrap-safe: single inference << counter period
    s += us; s2 += us * us;
    if (us < mn) mn = us;
    if (us > mx) mx = us;
  }
  double m  = s / N_BENCH;
  double sd = sqrt(s2 / N_BENCH - m * m);
  Serial.printf("cycle-ctr : mean %.3f us | sd %.3f us | min %.3f us | max %.3f us\n", m, sd, mn, mx);

  // ---- Step 5: headroom vs the 30-minute sample cycle ---------------------
  const double cycle_ms = 30.0 * 60.0 * 1000.0;  // 1,800,000 ms
  Serial.printf("Headroom  : %.0f x  (1,800,000 ms / %.5f ms)\n",
                cycle_ms / (mean_us / 1000.0), mean_us / 1000.0);

  Serial.println(F("--- copy the esp_timer mean, the sd, and the headroom into the paper ---"));
}

void loop() { /* nothing */ }
